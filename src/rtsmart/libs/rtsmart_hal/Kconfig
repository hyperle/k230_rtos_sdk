## src/rtsmart/libs/rtsmart_hal/Kconfig
```kconfig
menu "RT-Smart Userspace Hal Configuration"

    source "$(SDK_RTSMART_SRC_DIR)/libs/rtsmart_hal/drivers/Kconfig"
    source "$(SDK_RTSMART_SRC_DIR)/libs/rtsmart_hal/components/Kconfig"
    source "$(SDK_RTSMART_SRC_DIR)/libs/rtsmart_hal/utils/Kconfig"

endmenu
```

## src/uboot/uboot/board/kendryte/k230_canmv_gt6700/Kconfig
```kconfig
if TARGET_K230_CANMV_GT6700

	config SYS_CPU
		default "k230"

	config SYS_VENDOR
		default "kendryte"

	config SYS_BOARD
		default "k230_canmv_gt6700"

	config SYS_CONFIG_NAME
		default "k230_common"

	config BOARD_SPECIFIC_OPTIONS
		def_bool y
		select KENDRYTE_K230

	choice
		prompt "DDR Type And Frequency"
		default CANMV_GT6700_LPDDR4_2667

		config CANMV_GT6700_LPDDR4_2667
			bool "LPDDR4@2667"

		config CANMV_GT6700_LPDDR4_3200
			bool "LPDDR4@3200"
	endchoice

endif
```
