## configs/k230d_canmv_dart_v1_defconfig
```kconfig
CONFIG_BOARD_CONFIG_NAME="k230d_canmv_dart_v1_defconfig"
CONFIG_BOARD_K230D_RTOS_DART_V1=y
CONFIG_BOARD_NAME="CanMV_K230D_Dart_V1"
CONFIG_RTT_AUTO_EXEC_CMD="/sdcard/micropython &"
# CONFIG_ENABLE_NETWORK_RT_LAN_OVER_USB is not set
CONFIG_ENABLE_NETWORK_RT_WLAN=y
CONFIG_MPP_DEFAULT_SENSOR_CSI_0=y
CONFIG_MPP_ENABLE_CSI_DEV_0=y
CONFIG_MPP_CSI_DEV0_POWER=2
CONFIG_MPP_CSI_DEV0_RESET=-1
CONFIG_MPP_CSI_DEV0_I2C_DEV="i2c1"
CONFIG_MPP_CSI_DEV0_MCLK_INVALID=y
# CONFIG_MPP_ENABLE_CSI_DEV_1 is not set
# CONFIG_MPP_ENABLE_CSI_DEV_2 is not set
# CONFIG_MPP_ENABLE_SENSOR_SC038HGS is not set
CONFIG_MPP_ENABLE_SENSOR_SC132GS=y
CONFIG_MPP_SC132GS_SKIP_CHIP_ID_CHECK=y
CONFIG_MPP_SC132GS_I2C_ADDRESS=0x30
CONFIG_MPP_SC132GS_CSI0_4LANE=y
# CONFIG_MPP_SC132GS_CSI0_CLOCK_INVERT is not set
CONFIG_MPP_SC132GS_EXTCLK_HZ=24000000
# CONFIG_MPP_ENABLE_SENSOR_SC132GS_ON_CSI0_USE_CHIP_CLK is not set
CONFIG_OPENSBI_USE_PREBUILT_FW_JUMP=y
CONFIG_SDK_ENABLE_CANMV=y
# CONFIG_SDK_CANMV_COPY_EXAMPLES is not set
CONFIG_CANMV_REPL_UART_USB=y
# CONFIG_ENABLE_MODULE_WEBRTC is not set
# CONFIG_FAST_BOOT_CONFIGURATION is not set
```

## configs/k230d_rtos_dart_v1_defconfig
```kconfig
CONFIG_BOARD_CONFIG_NAME="k230d_rtos_dart_v1_defconfig"
CONFIG_BOARD_K230D_RTOS_DART_V1=y
CONFIG_RTT_AUTO_EXEC_CMD=""
CONFIG_ENABLE_NETWORK_RT_WLAN=y
CONFIG_RTSMART_3RD_PARTY_ENABLE_LIBPEER=y
CONFIG_MPP_DEFAULT_SENSOR_CSI_0=y
CONFIG_MPP_ENABLE_CSI_DEV_0=y
CONFIG_MPP_CSI_DEV0_POWER=2
CONFIG_MPP_CSI_DEV0_RESET=-1
CONFIG_MPP_CSI_DEV0_I2C_DEV="i2c1"
CONFIG_MPP_CSI_DEV0_MCLK_INVALID=y
# CONFIG_MPP_ENABLE_CSI_DEV_1 is not set
# CONFIG_MPP_ENABLE_CSI_DEV_2 is not set
# CONFIG_MPP_ENABLE_SENSOR_SC038HGS is not set
CONFIG_MPP_ENABLE_SENSOR_SC132GS=y
CONFIG_MPP_SC132GS_SKIP_CHIP_ID_CHECK=y
CONFIG_MPP_SC132GS_I2C_ADDRESS=0x30
CONFIG_MPP_SC132GS_CSI0_4LANE=y
# CONFIG_MPP_SC132GS_CSI0_CLOCK_INVERT is not set
CONFIG_MPP_SC132GS_EXTCLK_HZ=24000000
# CONFIG_MPP_ENABLE_SENSOR_SC132GS_ON_CSI0_USE_CHIP_CLK is not set
CONFIG_OPENSBI_USE_PREBUILT_FW_JUMP=y
# CONFIG_FAST_BOOT_CONFIGURATION is not set
# CONFIG_SDK_ENABLE_CANMV is not set
```
