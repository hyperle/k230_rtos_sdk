## boards/k230d_rtos_dart_v1/Kconfig
```kconfig
if BOARD_K230D_RTOS_DART_V1

    config BOARD_NOT_SUPPORT_HW_RTC
        def_bool y
endif
```

## configs/k230d_canmv_dart_v1_defconfig
```kconfig
CONFIG_BOARD_CONFIG_NAME="k230d_canmv_dart_v1_defconfig"
CONFIG_BOARD_K230D_RTOS_DART_V1=y
CONFIG_BOARD_NAME="CanMV_K230D_Dart_V1"
CONFIG_RTT_AUTO_EXEC_CMD="/sdcard/micropython &"
# CONFIG_ENABLE_NETWORK_RT_LAN_OVER_USB is not set
CONFIG_ENABLE_NETWORK_RT_WLAN=y
CONFIG_MPP_DEFAULT_SENSOR_CSI_2=y
CONFIG_MPP_ENABLE_CSI_DEV_2=y
CONFIG_MPP_CSI_DEV2_POWER=4
CONFIG_MPP_CSI_DEV2_I2C_DEV="i2c1"
CONFIG_MPP_ENABLE_SENSOR_SC038HGS=y
CONFIG_OPENSBI_USE_PREBUILT_FW_JUMP=y
CONFIG_SDK_ENABLE_CANMV=y
# CONFIG_SDK_CANMV_COPY_EXAMPLES is not set
CONFIG_CANMV_REPL_UART_USB=y
# CONFIG_ENABLE_MODULE_WEBRTC is not set
# CONFIG_FAST_BOOT_CONFIGURATION is not set
```

## configs/k230d_rtos_dart_v1_defconfig
```kconfig
CONFIG_BOARD_CONFIG_NAME="k230d_rtos_dart_v1_defconfig"
CONFIG_BOARD_K230D_RTOS_DART_V1=y
CONFIG_RTT_AUTO_EXEC_CMD="/sdcard/app/launcher &"
# CONFIG_ENABLE_NETWORK_RT_WLAN is not set
CONFIG_RTSMART_3RD_PARTY_ENABLE_LIBPEER=y
CONFIG_MPP_DEFAULT_SENSOR_CSI_2=y
CONFIG_MPP_ENABLE_CSI_DEV_2=y
CONFIG_MPP_CSI_DEV2_POWER=4
CONFIG_MPP_CSI_DEV2_I2C_DEV="i2c1"
CONFIG_MPP_ENABLE_SENSOR_SC038HGS=y
CONFIG_OPENSBI_USE_PREBUILT_FW_JUMP=y
# CONFIG_FAST_BOOT_CONFIGURATION is not set
```

## src/uboot/uboot/board/kendryte/k230d_rtos_dart_v1/Kconfig
```kconfig
if TARGET_K230D_RTOS_DART_V1

    config SYS_CPU
        default "k230"

    config SYS_VENDOR
        default "kendryte"

    config SYS_BOARD
        default "k230d_rtos_dart_v1"

    config SYS_CONFIG_NAME
        default "k230_common"

    config BOARD_SPECIFIC_OPTIONS
        def_bool y
        select KENDRYTE_K230

endif
```

## src/uboot/uboot/board/kendryte/k230d_y35/Kconfig
```kconfig
if TARGET_K230D_Y35

config SYS_CPU
	default "k230"

config SYS_VENDOR
	default "kendryte"

config SYS_BOARD
	default "k230d_y35"

config SYS_CONFIG_NAME
	default "k230_common"

config BOARD_SPECIFIC_OPTIONS
	def_bool y
	select KENDRYTE_K230

endif
```
